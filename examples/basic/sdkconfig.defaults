## examples/basic/sdkconfig.defaults
```kconfig
# 启用自定义分区表
CONFIG_PARTITION_TABLE_CUSTOM=y
CONFIG_PARTITION_TABLE_CUSTOM_FILENAME="partitions.csv"
CONFIG_PARTITION_TABLE_FILENAME="partitions.csv"

# FAT 文件系统配置（基于 wear levelling）
CONFIG_FATFS_LFN_HEAP=y
CONFIG_FATFS_MAX_LFN=127

# TinyUSB MSC 配置
CONFIG_TINYUSB_MSC_ENABLED=y
CONFIG_TINYUSB_MSC_BUFSIZE=4096
```
